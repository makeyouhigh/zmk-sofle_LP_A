## boards/arm/eyelash_sofle/Kconfig.defconfig
```kconfig
#
# Copyright (c) 2024 The ZMK Contributors
# SPDX-License-Identifier: MIT
#

if BOARD_EYELASH_SOFLE_LEFT

config ZMK_KEYBOARD_NAME
    default "Eyelash Sofle"

config ZMK_SPLIT_ROLE_CENTRAL
    default y


endif # BOARD_EYELASH_SOFLE_LEFT


if BOARD_EYELASH_SOFLE_LEFT || BOARD_EYELASH_SOFLE_RIGHT

config BOARD
    default "eyelash_sofle"

config BOARD_ENABLE_DCDC
    bool "Enable DCDC mode"
    select SOC_DCDC_NRF52X
    default y
    depends on (BOARD_EYELASH_SOFLE_LEFT || BOARD_EYELASH_SOFLE_RIGHT)

config BOARD_ENABLE_DCDC_HV
    bool "Enable High Voltage DCDC converter"
    default y
    select SOC_DCDC_NRF52X_HV
    depends on (BOARD_EYELASH_SOFLE_LEFT || BOARD_EYELASH_SOFLE_RIGHT)

config ZMK_SPLIT
    default y

config BT_CTLR
    default BT

if USB

config USB_NRFX
    default y

config USB_DEVICE_STACK
    default y

endif # USB

if ZMK_DISPLAY

config I2C
    default y

config SSD1306
    default y

choice ZMK_DISPLAY_WORK_QUEUE
    default ZMK_DISPLAY_WORK_QUEUE_DEDICATED
endchoice

endif

if SSD1306

config LV_Z_VDB_SIZE
    default 64

config LV_DPI_DEF
    default 148

config LV_Z_BITS_PER_PIXEL
    default 1

choice LV_COLOR_DEPTH
    default LV_COLOR_DEPTH_1
endchoice

endif

if ZMK_BACKLIGHT

config PWM
    default y

config LED_PWM
    default y

endif # ZMK_BACKLIGHT

# 20250417

    if ZMK_SPLIT && ZMK_SPLIT_BLE
    
    menu "BLE Transport"
    
    # Bump this value needed for concurrent GATT discovery of splits
    config BT_L2CAP_TX_BUF_COUNT
        default 5 if ZMK_SPLIT_ROLE_CENTRAL
    
    if ZMK_SPLIT_ROLE_CENTRAL
    
    config ZMK_SPLIT_BLE_CENTRAL_PERIPHERALS
        int "Number of peripherals that will connect to the central."
    
    menuconfig ZMK_SPLIT_BLE_CENTRAL_BATTERY_LEVEL_FETCHING
        bool "Fetch Peripheral Battery Level Info"
        help
          Adds internal support for fetching the battery levels from peripherals
          and generating events in the ZMK eventing system.
    
    if ZMK_SPLIT_BLE_CENTRAL_BATTERY_LEVEL_FETCHING
    
    config ZMK_SPLIT_BLE_CENTRAL_BATTERY_LEVEL_QUEUE_SIZE
        int "Max number of battery level events to queue when received from peripherals"
        default ZMK_SPLIT_BLE_CENTRAL_PERIPHERALS
    
    config ZMK_SPLIT_BLE_CENTRAL_BATTERY_LEVEL_PROXY
        bool "Proxy Peripheral Battery Level Info"
        default y
        help
          Adds support for reporting the battery levels of connected split
          peripherals through an additional Battery Level service.
    
    endif
    
    config ZMK_SPLIT_BLE_CENTRAL_POSITION_QUEUE_SIZE
        int "Max number of key position state events to queue when received from peripherals"
        default 5
    
    config ZMK_SPLIT_BLE_CENTRAL_SPLIT_RUN_STACK_SIZE
        int "BLE split central write thread stack size"
        default 512
    
    config ZMK_SPLIT_BLE_CENTRAL_SPLIT_RUN_QUEUE_SIZE
        int "Max number of behavior run events to queue to send to the peripheral(s)"
        default 5
    
    config ZMK_SPLIT_BLE_PREF_INT
        int "Connection interval to use for split central/peripheral connection"
        default 6
    
    config ZMK_SPLIT_BLE_PREF_LATENCY
        int "Latency to use for split central/peripheral connection"
        default 30
    
    config ZMK_SPLIT_BLE_PREF_TIMEOUT
        int "Supervision timeout to use for split central/peripheral connection"
        default 400
    
    endif # ZMK_SPLIT_ROLE_CENTRAL
    
    if !ZMK_SPLIT_ROLE_CENTRAL
    
    config ZMK_SPLIT_BLE_PERIPHERAL_STACK_SIZE
        int "BLE split peripheral notify thread stack size"
        default 756
    
    config ZMK_SPLIT_BLE_PERIPHERAL_PRIORITY
        int "BLE split peripheral notify thread priority"
        default 5
    
    config ZMK_SPLIT_BLE_PERIPHERAL_POSITION_QUEUE_SIZE
        int "Max number of key position state events to queue to send to the central"
        default 10
    
    config BT_MAX_PAIRED
        default 1
    
    config BT_MAX_CONN
        default 1
    
    # Allow central to specify connection parameters.
    config BT_GAP_AUTO_UPDATE_CONN_PARAMS
        default n
    
    endif # !ZMK_SPLIT_ROLE_CENTRAL
    
    endmenu
    
    endif # ZMK_SPLIT_BLE# 20250417

endif # BOARD_EYELASH_SOFLE_LEFT || BOARD_EYELASH_SOFLE_RIGHT
```
